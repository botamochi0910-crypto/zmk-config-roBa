## config/west.yml
```yaml
manifest:
  remotes:
    - name: zmkfirmware
      url-base: https://github.com/zmkfirmware
    - name: botamochi
      url-base: https://github.com/botamochi0910-crypto

  projects:
    - name: zmk
      remote: zmkfirmware
      revision: main
      import: app/west.yml

    - name: zmk-pmw3610-driver
      remote: botamochi
      revision: main
      path: zmk-pmw3610-driver

  self:
    path: config
```
